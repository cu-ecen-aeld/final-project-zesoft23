## base_external/configs/morse_qemu_defconfig
```kconfig
BR2_arm=y
BR2_cortex_a8=y
BR2_TARGET_GENERIC_HOSTNAME="morsebeaglebone"
BR2_TARGET_GENERIC_ROOT_PASSWD="root"
BR2_LINUX_KERNEL=y
BR2_LINUX_KERNEL_USE_ARCH_DEFAULT_CONFIG=y
BR2_LINUX_KERNEL_NEEDS_HOST_OPENSSL=y
BR2_TARGET_UBOOT=y
BR2_TARGET_UBOOT_BOARD_DEFCONFIG="am335x_evm"
BR2_TARGET_UBOOT_FORMAT_IMG=y
BR2_TARGET_UBOOT_SPL=y
BR2_TARGET_UBOOT_SPL_NAME="MLO"
BR2_PACKAGE_MORSE_CODE_DRIVER=y
```

## base_external/package/morse-code-driver/Config.in
```kconfig
config BR2_PACKAGE_MORSE_CODE_DRIVER
	bool "morse-code-driver"
	help
	  Includes the writer executable, finder.sh and tester.sh in the kernel image.
	  Used to understand buildroot external trees and package builds.
```
